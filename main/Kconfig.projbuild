## main/Kconfig.projbuild
```kconfig
menu "MusicPlayer"

    config MUSICPLAYER_LASTFM_API_KEY
        string "Last.fm API key"
        default ""
        help
            API key from https://www.last.fm/api/account/create. Leave empty to disable Last.fm scrobbling.

    config MUSICPLAYER_LASTFM_API_SECRET
        string "Last.fm shared secret"
        default ""
        help
            Shared secret for the Last.fm API key. Leave empty to disable Last.fm scrobbling.

    config MUSICPLAYER_LASTFM_BOOTSTRAP_USERNAME
        string "Last.fm bootstrap username"
        default ""
        help
            Optional first-run username. If no saved session exists, MusicPlayer will use this once to request a session.

    config MUSICPLAYER_LASTFM_BOOTSTRAP_PASSWORD
        string "Last.fm bootstrap password"
        default ""
        help
            Optional first-run password. It is only used to request a Last.fm session and is not saved in NVS.

    config MUSICPLAYER_JELLYFIN_URL
        string "Jellyfin server URL"
        default ""
        help
            Base URL for a Jellyfin server, for example http://192.168.1.20:8096. Leave empty to disable Jellyfin.

    config MUSICPLAYER_JELLYFIN_TOKEN
        string "Jellyfin API token"
        default ""
        help
            API token from the Jellyfin dashboard. Leave empty to disable Jellyfin.

    config MUSICPLAYER_JELLYFIN_USER_ID
        string "Jellyfin user id"
        default ""
        help
            Optional Jellyfin user id used for user-scoped library and stream requests.

endmenu
```
